## subsys/Kconfig
```kconfig
menu "subsys"

config FIREFLY_DEBUG
	bool "Firefly Debug"
	help
	  Enable Firefly debugging.

rsource "base/Kconfig"
rsource "ble/Kconfig"
rsource "boot/Kconfig"
rsource "crypto/Kconfig"
rsource "graphics/Kconfig"
rsource "rpc/Kconfig"
rsource "storage/Kconfig"
rsource "swd/Kconfig"
rsource "usb/Kconfig"
rsource "ux/Kconfig"

endmenu
```

## subsys/base/Kconfig
```kconfig
config FIREFLY_SUBSYS_BASE_GPIO_PORT_COUNT
	int "GPIO port count"
	default 2
	help
	  Number of GPIO ports.

menuconfig FIREFLY_SUBSYS_BASE
	bool "base"
    select HWINFO
	help
	  Include base firmware in the system configuration.

if FIREFLY_SUBSYS_BASE

config FIREFLY_SUBSYS_BASE_LOG
	bool "BASE LOG"
	help
	  Enable Firefly Base Log.

config FIREFLY_SUBSYS_BASE_LOG_LIMIT
	int "BASE LOG LIMIT"
	default 256
	help
	  Enable Firefly Base Log Limit.

config FIREFLY_SUBSYS_BASE_ASSERT_LOG_LIMIT
     int "firefly assert log limit"
     default 1

config FIREFLY_SUBSYS_BASE_TEST
	bool "BASE TEST"
	help
	  Enable Firefly Base Test.

config FIREFLY_SUBSYS_BASE_ADC_NRF5
	bool "BASE ADC NRF5"
	help
	  Enable Firefly Base ADC nRF5.

config FIREFLY_SUBSYS_BASE_I2CM_NRF5
	bool "BASE I2CM NRF5"
	help
	  Enable Firefly Base I2CM nRF5.

config FIREFLY_SUBSYS_BASE_INTERRUPT_NRF5
	bool "BASE INTERRUPT NRF5"
	help
	  Enable Firefly Base INTERRUPT nRF5.

config FIREFLY_SUBSYS_BASE_PWM_NRF5
	bool "BASE PWM NRF5"
	help
	  Enable Firefly Base PWM nRF5.

config FIREFLY_SUBSYS_BASE_RTC_NRF5
	bool "BASE RTC NRF5"
	help
	  Enable Firefly Base RTC nRF5.

config FIREFLY_SUBSYS_BASE_SPIM_NRF5
	bool "BASE SPIM NRF5"
	help
	  Enable Firefly Base SPIM nRF5.

config FIREFLY_SUBSYS_BASE_TIMING_NRF5
	bool "BASE TIMING NRF5"
	help
	  Enable Firefly Base TIMING nRF5.

config FIREFLY_SUBSYS_BASE_TIMING_STM32
	bool "BASE TIMING STM32"
	help
	  Enable Firefly Base TIMING STM32.

config FIREFLY_SUBSYS_BASE_UART_NRF5
	bool "BASE UART NRF5"
	help
	  Enable Firefly Base UART nRF5.

config FIREFLY_SUBSYS_BASE_WORK_ZEPHYR
	bool "BASE WORK ZEPHYR"
	help
	  Enable Firefly Base Work Zephyr.

endif
```

## subsys/ble/Kconfig
```kconfig
menuconfig FIREFLY_SUBSYS_BLE
	bool "BLE"
	help
	  Include BLE firmware in the system configuration.

if FIREFLY_SUBSYS_BLE

endif
```

## subsys/boot/Kconfig
```kconfig
menuconfig FIREFLY_SUBSYS_BOOT
	bool "boot"

if FIREFLY_SUBSYS_BOOT

config FIREFLY_SUBSYS_BOOT_NRF53
        bool "firefly subsys boot nRF53 executor"
	help
	  firefly subsys boot nRF53 executor

config FIREFLY_SUBSYS_BOOT_SPLIT_CONTROLLER
        bool "firefly subsys boot split controller"
	help
	  firefly subsys boot split controller

config FIREFLY_SUBSYS_BOOT_SPLIT_PERIPHERAL
        bool "firefly subsys boot split peripheral"
	help
	  firefly subsys boot split peripheral

config FIREFLY_SUBSYS_BOOT_ZEPHYR
        bool "firefly subsys boot zephyr SHA & AES"
        select MBEDTLS
        select MBEDTLS_MAC_SHA1_ENABLED
        select MBEDTLS_CIPHER_AES_ENABLED
	help
	  firefly subsys boot zephyr SHA & AES

endif
```

## subsys/crypto/Kconfig
```kconfig
menuconfig FIREFLY_SUBSYS_CRYPTO
	bool "crypo"

if FIREFLY_SUBSYS_CRYPTO

config FIREFLY_SUBSYS_CRYPTO_AES
        bool "Enable AES 128 CBC"
	help
	  Build AES 128 CBC

config FIREFLY_SUBSYS_CRYPTO_SHA
        bool "Enable SHA-1"
	help
	  Build SHA-1

endif
```

## subsys/graphics/Kconfig
```kconfig
menuconfig FIREFLY_SUBSYS_GRAPHICS
	bool "graphics"
	help
	  Include graphics firmware in the system configuration.

if FIREFLY_SUBSYS_GRAPHICS

config FIREFLY_SUBSYS_GRAPHICS_ILI9341
	bool "ILI9341"
	help
	  Enable Firefly Graphics ILI9341.

config FIREFLY_SUBSYS_GRAPHICS_SSD1327
	bool "SSD1327"
	help
	  Enable Firefly Graphics SSD1327.

config FIREFLY_SUBSYS_GRAPHICS_GC9A01
	bool "GC9A01"
	help
	  Enable Firefly Graphics GC9A01.

config FIREFLY_SUBSYS_GRAPHICS_CST816S
	bool "CST816S"
	help
	  Enable Firefly Graphics Touch Screen CST816S.

config FIREFLY_SUBSYS_GRAPHICS_SSD1331
	bool "SSD1331"
	help
	  Enable Firefly Graphics SSD1327.

config FIREFLY_SUBSYS_GRAPHICS_TXDC0421A1
	bool "TXDC0421A1"
	help
	  Enable Firefly Graphics TXDC0421A1.

endif
```

## subsys/rpc/Kconfig
```kconfig
config FIREFLY_SUBSYS_RPC_THREAD
    bool "RPC Thread"
    help
       Build RPC Thread
       
config FIREFLY_SUBSYS_RPC_PROTOBUF
    bool "RPC Protobuf"
    help
       Build RPC Protobuf
       
menuconfig FIREFLY_SUBSYS_RPC
	bool "RPC"
    select FIREFLY_SUBSYS_RPC_PROTOBUF
	help
	  Include protobuf services remote procedure call firmware in the system configuration.

if FIREFLY_SUBSYS_RPC

config FIREFLY_SUBSYS_RPC_BUFFER_COUNT
	int "RPC BUFFER COUNT"
    default 4
	help
	  Number of buffers to use for RPC message transfers.

config FIREFLY_SUBSYS_RPC_BUFFER_SIZE
	int "RPC BUFFER SIZE"
    default 1024
	help
	  Buffer size to use for RPC message transfers.

config FIREFLY_SUBSYS_RPC_USB_TX_BUFFER_SIZE
	int "RPC USB TX BUFFER SIZE"
    default 2048
	help
	  Buffer size to use for RPC USB TX buffer.

config FIREFLY_SUBSYS_RPC_USB_RX_BUFFER_SIZE
	int "RPC USB RX BUFFER SIZE"
    default 2048
	help
	  Buffer size to use for RPC USB RX buffer.

config FIREFLY_SUBSYS_RPC_THREAD_TX_BUFFER_SIZE
	int "RPC THREAD TX BUFFER SIZE"
    default 2048
	help
	  Buffer size to use for RPC THREAD TX buffer.

config FIREFLY_SUBSYS_RPC_THREAD_RX_BUFFER_SIZE
	int "RPC THREAD RX BUFFER SIZE"
    default 2048
	help
	  Buffer size to use for RPC THREAD RX buffer.

config FIREFLY_SUBSYS_RPC_THREAD_SEND_BUFFER_SIZE
	int "RPC THREAD SEND BUFFER SIZE"
    default 1024
	help
	  Buffer size to use for RPC THREAD send buffer.

config FIREFLY_SUBSYS_RPC_THREAD_RECEIVE_BUFFER_SIZE
	int "RPC THREAD RECEIVE BUFFER SIZE"
    default 1024
	help
	  Buffer size to use for RPC THREAD receive buffer.

config FIREFLY_SUBSYS_RPC_CLIENT_CONTEXT_LIMIT
	int "RPC CLIENT CONTEXT LIMIT"
    default 4
	help
	  Limit on the number of client contents.

config FIREFLY_SUBSYS_RPC_SERVER_CONTEXT_LIMIT
	int "RPC CLIENT SERVER LIMIT"
    default 4
	help
	  Limit on the number of server contents.

config FIREFLY_SUBSYS_RPC_SERVER_METHOD_LIMIT
	int "RPC SERVER METHOD LIMIT"
    default 4
	help
	  Limit on the number of server methods.

endif
```

## subsys/storage/Kconfig
```kconfig
menuconfig FIREFLY_SUBSYS_STORAGE
	bool "storage"
	help
	  Include storage firmware in the system configuration.

if FIREFLY_SUBSYS_STORAGE

config FIREFLY_SUBSYS_STORAGE_FATFS
        bool "include FATFS storage functions"
	help
	  Build FATFS storage functions.

config FIREFLY_SUBSYS_STORAGE_QSPI_ENTER_FOUR_BYTE_ADDRESSING_MODE
        bool "Enable QSPI four byte addressing"
	help
	  Enable entering four byte addressing mode for nRF QSPI during kernel initialization.

if FIREFLY_SUBSYS_STORAGE_QSPI_ENTER_FOUR_BYTE_ADDRESSING_MODE

config FIREFLY_SUBSYS_STORAGE_QSPI_ENTER_FOUR_BYTE_ADDRESSING_MODE_OPCODE
        hex "Opcode for entering four byte addressing mode"
        default 0xB7
	help
	  Define the opcode for entering four byte addressing mode.

endif

config FIREFLY_SUBSYS_STORAGE_SDCARD
        bool "Enable SDCARD functions"
	help
	  Build SDCARD functions.

endif
```

## subsys/swd/Kconfig
```kconfig
menuconfig FIREFLY_SUBSYS_SWD
	bool "SWD"
    select HWINFO
	help
	  Include ARM Cortex Serial Wire Debug firmware in the system configuration.
```

## subsys/usb/Kconfig
```kconfig
menuconfig FIREFLY_SUBSYS_USB
	bool "USB"
	help
	  Include USB firmware in the system configuration.

if FIREFLY_SUBSYS_USB

config FIREFLY_SUBSYS_USB_CDC
	bool "USB CDC"
	help
	  Enable Firefly USB CDC.

config FIREFLY_SUBSYS_USB_MSC
	bool "USB MSC"
	help
	  Enable Firefly USB MSC.

endif
```

## subsys/ux/Kconfig
```kconfig
menuconfig FIREFLY_SUBSYS_UX
	bool "ux"
    depends on NANOPB
	help
	  Include ux firmware in the system configuration.

config FIREFLY_SUBSYS_UX_BUTTON_LIMIT
	int "UX BUTTON LIMIT"
	default 2
	help
	  Firefly UX Button Limit.
```

## west.yml
```yaml
manifest:
  remotes:
    - name: ncs
      url-base: https://github.com/nrfconnect
    - name: denisbohm
      url-base: https://github.com/denisbohm
  projects:
    - name: sdk-nrf
      remote: ncs
      path: nrf
      revision: v2.1.0
      import: true
      clone-depth: 1
  self:
      path: firefly-zephyr
```
