## prj.conf
```kconfig
CONFIG_FLASH_BASE_ADDRESS=0x80000
CONFIG_HAVE_CUSTOM_LINKER_SCRIPT=y
CONFIG_CUSTOM_LINKER_SCRIPT="linker.ld"

# Drivers and peripherals
CONFIG_I2C=n
CONFIG_WATCHDOG=n
CONFIG_GPIO=n
CONFIG_PINMUX=n
CONFIG_SPI=n
CONFIG_SERIAL=n
CONFIG_FLASH=n

# Power management
CONFIG_PM=n

# Interrupts
CONFIG_DYNAMIC_INTERRUPTS=n
CONFIG_IRQ_OFFLOAD=n

# Memory protection
CONFIG_THREAD_STACK_INFO=n
CONFIG_THREAD_CUSTOM_DATA=n
CONFIG_FPU=n

# Boot
CONFIG_BOOT_BANNER=n
CONFIG_BOOT_DELAY=0

# Console
CONFIG_CONSOLE=n
CONFIG_UART_CONSOLE=n
CONFIG_STDOUT_CONSOLE=n
CONFIG_PRINTK=n
CONFIG_EARLY_CONSOLE=n

# Build
CONFIG_SIZE_OPTIMIZATIONS=y

CONFIG_MULTITHREADING=n
CONFIG_KERNEL_MEM_POOL=n

CONFIG_SYS_CLOCK_EXISTS=n

CONFIG_ARM_MPU=n
```

## src/main.c
```c
#include <hal/nrf_gpio.h>

void busy_wait(uint32_t ms) {
    for (volatile int i = 0; i < ms; ++i) {
        for (volatile int j = 0; j < 16000; ++j) {
        }
    }
}

void main(void) {
    const uint32_t pin = 31;
    const uint32_t delay = 250;

    nrf_gpio_cfg_output(pin);
    while (true) {
        nrf_gpio_pin_clear(pin);
        busy_wait(delay);
	    nrf_gpio_pin_set(pin);
        busy_wait(delay);
    }
}
```
