## CMakeLists.txt
```
cmake_minimum_required(VERSION 3.13.1)

set(BOARD nrf5340dk_nrf5340_cpuapp)

cmake_path(GET CMAKE_CURRENT_LIST_DIR PARENT_PATH FIREFLY_ZEPHYR_APPLICATIONS_BOOT_DIR)
cmake_path(GET FIREFLY_ZEPHYR_APPLICATIONS_BOOT_DIR PARENT_PATH FIREFLY_ZEPHYR_APPLICATIONS_DIR)
cmake_path(GET FIREFLY_ZEPHYR_APPLICATIONS_DIR PARENT_PATH FIREFLY_ZEPHYR_DIR)
set(ZEPHYR_EXTRA_MODULES ${FIREFLY_ZEPHYR_DIR})

find_package(Zephyr HINTS $ENV{ZEPHYR_BASE})

project(boot_usb)

set(CMAKE_BUILD_TYPE Debug)

target_sources(app PRIVATE
    src/main.c
    ../../../subsys/boot/src/fd_boot_zephyr.c
    ../../../subsys/storage/src/fd_storage_fatfs.c
)
```

## prj.conf
```kconfig
CONFIG_FIREFLY_SUBSYS_BOOT=y
CONFIG_FIREFLY_SUBSYS_BOOT_NRF53=y
#CONFIG_FIREFLY_SUBSYS_BOOT_ZEPHYR=y

CONFIG_FIREFLY_SUBSYS_STORAGE=y
#CONFIG_FIREFLY_SUBSYS_STORAGE_FATFS=y

CONFIG_FIREFLY_SUBSYS_USB=y
CONFIG_FIREFLY_SUBSYS_USB_CDC=y
CONFIG_FIREFLY_SUBSYS_USB_MSC=y

CONFIG_FIREFLY_SUBSYS_CRYPTO=y
CONFIG_FIREFLY_SUBSYS_CRYPTO_AES=y
CONFIG_FIREFLY_SUBSYS_CRYPTO_SHA=y

CONFIG_SERIAL=y
CONFIG_USB_DEVICE_STACK=y
CONFIG_USB_DEVICE_PRODUCT="Firefly Boot Loader"
CONFIG_USB_CDC_ACM=y
CONFIG_USB_WORKQUEUE_STACK_SIZE=8192
CONFIG_USB_NRFX_WORK_QUEUE_STACK_SIZE=8192
CONFIG_USB_MASS_STORAGE=y
CONFIG_MASS_STORAGE_STACK_SIZE=8192
CONFIG_MASS_STORAGE_DISK_NAME="NAND"

CONFIG_FILE_SYSTEM=y
CONFIG_FAT_FILESYSTEM_ELM=y

CONFIG_DISK_DRIVER_FLASH=y
CONFIG_FLASH_MAP=y
CONFIG_FLASH_PAGE_LAYOUT=y
CONFIG_DISK_FLASH_START=0x0
CONFIG_NORDIC_QSPI_NOR_FLASH_LAYOUT_PAGE_SIZE=4096
CONFIG_DISK_FLASH_DEV_NAME="MX25R64"
CONFIG_DISK_VOLUME_SIZE=0x20000
CONFIG_DISK_FLASH_MAX_RW_SIZE=4096
CONFIG_DISK_FLASH_ERASE_ALIGNMENT=0x1000
CONFIG_DISK_ERASE_BLOCK_SIZE=0x1000
CONFIG_NORDIC_QSPI_NOR=y

CONFIG_MBEDTLS=y
CONFIG_MBEDTLS_BUILTIN=y
CONFIG_MBEDTLS_MAC_SHA1_ENABLED=y
CONFIG_MBEDTLS_CIPHER_AES_ENABLED=y

CONFIG_NO_OPTIMIZATIONS=y
CONFIG_DEBUG_THREAD_INFO=y
CONFIG_EXTRA_EXCEPTION_INFO=y
CONFIG_RESET_ON_FATAL_ERROR=n
CONFIG_MAIN_STACK_SIZE=8192
CONFIG_SYSTEM_WORKQUEUE_STACK_SIZE=8192
CONFIG_IDLE_STACK_SIZE=8192
CONFIG_ISR_STACK_SIZE=8192

CONFIG_LOG=y
CONFIG_CONSOLE=n
CONFIG_UART_CONSOLE=n
CONFIG_PRINTK=n
CONFIG_REBOOT=y

CONFIG_PM_DEVICE=y

CONFIG_NEWLIB_LIBC=y

CONFIG_NFCT_PINS_AS_GPIOS=y
```

## src/main.c
```c
#include "fd_boot.h"
#include "fd_boot_nrf53.h"
#include "fd_boot_zephyr.h"
#include "fd_storage_fatfs.h"
#include "fd_usb.h"
#include "fd_usb_msc.h"

#include <zephyr/kernel.h>

#include <nrf5340_application.h>

#include <hal/nrf_gpio.h>

#include <string.h>

#define FD_BOOT_EXECUTABLE_STORAGE_LOCATION 0x80000
#define FD_BOOT_EXECUTABLE_STORAGE_LENGTH (32 * 1024)

#define FD_BOOT_EXECUTABLE_LOCATION 0x80000
#define FD_BOOT_EXECUTABLE_METADATA_OFFSET 0x180

#define FD_BOOT_DECRYPTION_KEY 0x00, 0x01, 0x02, 0x03, 0x04, 0x05, 0x06, 0x07, 0x08, 0x09, 0x0a, 0x0b, 0x0c, 0x0d, 0x0e, 0x0f

bool fd_boot_zephyr_get_executable_storage(fd_boot_info_executable_storage_t *storage, fd_boot_error_t *error) {
    *storage = (fd_boot_info_executable_storage_t) {
        .range = {
            .location = FD_BOOT_EXECUTABLE_STORAGE_LOCATION,
            .length = FD_BOOT_EXECUTABLE_STORAGE_LENGTH,
        },
    };
    return true;
}

bool fd_boot_zephyr_get_executable(fd_boot_info_executable_t *executable, fd_boot_error_t *error) {
    *executable = (fd_boot_info_executable_t) {
        .location = FD_BOOT_EXECUTABLE_LOCATION,
        .metadata_offset = FD_BOOT_EXECUTABLE_METADATA_OFFSET,
    };
    return true;
}

bool fd_boot_zephyr_get_decryption(fd_boot_info_decryption_t *decryption, fd_boot_error_t *error) {
    const uint8_t key[] = { FD_BOOT_DECRYPTION_KEY };
    memcpy(decryption->key.data, key, FD_BOOT_CRYPTO_KEY_SIZE);
    return true;
}

void fd_boot_zephyr_feed(void) {
}

bool fd_boot_zephyr_can_upgrade(const fd_boot_version_t *executable_version, const fd_boot_version_t *update_version) {
    return true;
}

bool fd_boot_zephyr_can_downgrade(const fd_boot_version_t *executable_version, const fd_boot_version_t *update_version) {
    return false;
}

bool fd_boot_zephyr_can_install(const fd_boot_version_t *version) {
    return true;
}

void fd_boot_zephyr_progress(float amount) {
}

void fd_boot_usb_start(void) {
    fd_usb_msc_initialize();
    fd_usb_initialize(0);
}

fd_boot_update_interface_t fd_boot_update_interface = {
    .info = {
        .get_executable_storage = fd_boot_zephyr_get_executable_storage,
        .get_executable = fd_boot_zephyr_get_executable,
        .get_update_storage = fd_boot_zephyr_get_update_storage,
        .get_decryption = fd_boot_zephyr_get_decryption,
    },
    .status = {
        .progress = fd_boot_zephyr_progress,
    },
    .watchdog = {
        .feed = fd_boot_zephyr_feed,
    },
    .hash = {
        .initialize = fd_boot_zephyr_hash_initialize,
        .update = fd_boot_zephyr_hash_update,
        .finalize = fd_boot_zephyr_hash_finalize,
    },
    .decrypt = {
        .initialize = fd_boot_zephyr_decrypt_initialize,
        .update = fd_boot_zephyr_decrypt_update,
        .finalize = fd_boot_zephyr_decrypt_finalize,
    },
    .executable_reader = {
        .context = 0,
        .read = fd_boot_zephyr_executable_read,
    },
    .executable_flasher = {
        .context = 0,
        .erase = fd_boot_nrf53_flasher_erase,
        .write = fd_boot_nrf53_flasher_write,
        .finalize = fd_boot_nrf53_flasher_finalize,
    },
    .update_reader = {
        .context = 0,
        .read = fd_boot_zephyr_update_read,
    },
    .action = {
        .can_upgrade = fd_boot_zephyr_can_upgrade,
        .can_downgrade = fd_boot_zephyr_can_downgrade,
        .can_install = fd_boot_zephyr_can_install,
    },
    .executor = {
        .cleanup = fd_boot_zephyr_executor_cleanup,
        .start = fd_boot_nrf53_executor_start,
    },
};

void fd_boot_try_execute(void) {
    fd_boot_error_t error;
    fd_boot_get_executable_metadata_result_t executable;
    if (!fd_boot_get_executable_metadata(&fd_boot_update_interface, &executable, &error)) {
        return;
    }
    if (!fd_boot_execute(&fd_boot_update_interface, &error)) {
        // cant execute
    }
}

void fd_boot_try_update(void) {
    fd_boot_error_t error;
    if (!fd_boot_zephyr_update_storage_open("NAND:/update.bin", &error)) {
        fd_boot_try_execute();
        return;
    }

    fd_boot_update_result_t result;
    if (!fd_boot_update(&fd_boot_update_interface, &result, &error)) {
        // printf("error %d\n", error.code);
    } else {
        if (result.is_valid) {
            // printf("is valid\n");
            if (!fd_boot_execute(&fd_boot_update_interface, &error)) {
                // cant execute
            }
        } else {
            // printf("issue %d\n", result.issue);
        }
    }
}

int main(void) {
    fd_storage_fatfs_initialize();
    if (!fd_storage_fatfs_open()) {
        fd_boot_try_execute();
        return 1;
    }
    if (fd_storage_fatfs_mount()) {
        const uint32_t button_1_pin = 23;
        nrf_gpio_cfg_input(button_1_pin, NRF_GPIO_PIN_NOPULL);
        if (nrf_gpio_pin_read(button_1_pin) != 0) {
            fd_boot_try_update();
        }
        fd_storage_fatfs_unmount();
    }

    static uint8_t buffer[4096];
    if (!fd_storage_fatfs_format(buffer, sizeof(buffer))) {
        // printf("error %d\n", error.code);
        return 1;
    }

    if (fd_storage_fatfs_mount()) {
        fd_boot_usb_start();
    }
    
    return 0;
}
```
