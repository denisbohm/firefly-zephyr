## CMakeLists.txt
```
cmake_minimum_required(VERSION 3.13.1)

set(BOARD nrf5340dk_nrf5340_cpuapp)

find_package(Zephyr HINTS $ENV{ZEPHYR_BASE})

project(blinky)

set(CMAKE_BUILD_TYPE Debug)

target_sources(app PRIVATE
    src/main.c
    src/executable_metadata.c
)
```

## prj.conf
```kconfig
CONFIG_FLASH_BASE_ADDRESS=0x80000
#CONFIG_CODE_DATA_RELOCATION=y
CONFIG_HAVE_CUSTOM_LINKER_SCRIPT=y
CONFIG_CUSTOM_LINKER_SCRIPT="linker.ld"

# Drivers and peripherals
CONFIG_I2C=n
CONFIG_WATCHDOG=n
CONFIG_GPIO=n
CONFIG_PINMUX=n
CONFIG_SPI=n
CONFIG_SERIAL=n
CONFIG_FLASH=n

# Power management
CONFIG_PM=n

# Interrupts
CONFIG_DYNAMIC_INTERRUPTS=n
CONFIG_IRQ_OFFLOAD=n

# Memory protection
CONFIG_THREAD_STACK_INFO=n
CONFIG_THREAD_CUSTOM_DATA=n
CONFIG_FPU=n

# Boot
CONFIG_BOOT_BANNER=n
CONFIG_BOOT_DELAY=0

# Console
CONFIG_CONSOLE=n
CONFIG_UART_CONSOLE=n
CONFIG_STDOUT_CONSOLE=n
CONFIG_PRINTK=n
CONFIG_EARLY_CONSOLE=n

# Build
CONFIG_SIZE_OPTIMIZATIONS=y

CONFIG_MULTITHREADING=n
CONFIG_KERNEL_MEM_POOL=n

CONFIG_SYS_CLOCK_EXISTS=n

CONFIG_ARM_MPU=n
```

## src/executable_metadata.c
```c
#include <stdint.h>

typedef struct {
    uint32_t magic;
    uint32_t version;
    uint32_t major;
    uint32_t minor;
    uint32_t patch;
    uint32_t length;
    uint8_t hash[20];
    uint8_t reserved[20];
} executable_metadata_t;

__attribute__((section(".executable_metadata_section")))
executable_metadata_t executable_metadata = {
    .magic = 0xb001da1a,
    .version = 1,
    .major = 1,
    .minor = 2,
    .patch = 3,
};
```
